## boards/shields/meowcorne/Kconfig.shield
```kconfig
config SHIELD_MEOWCORNE_LEFT
    def_bool $(shields_list_contains,meowcorne_left)

config SHIELD_MEOWCORNE_RIGHT
    def_bool $(shields_list_contains,meowcorne_right)
```
